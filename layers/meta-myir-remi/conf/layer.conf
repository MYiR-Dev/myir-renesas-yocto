## layers/meta-myir-remi/conf/layer.conf
```bitbake
include ${LAYERDIR}/include/codec/plugin.inc
include ${LAYERDIR}/include/demos/demos.inc
#include ${LAYERDIR}/include/codec/plugin.inc
#include ${LAYERDIR}/include/codec/omx-control.inc
include ${LAYERDIR}/include/openamp/openamp.inc
include ${LAYERDIR}/include/graphic/feature.inc
#include ${LAYERDIR}/include/rz-plugins.inc
#include ${LAYERDIR}/include/rz-graphics.inc

LAYERDEPENDS_myir-yg2lx = "core"
LAYERDEPENDS_myir-yg2lx = "core yocto yoctobsp openembedded-layer meta-python"

LAYERDEPENDS_myir-yg2lx-1g = "core"
LAYERDEPENDS_myir-yg2lx-1g = "core yocto yoctobsp openembedded-layer meta-python"

LAYERDEPENDS_myir-remi-1g = "core"
LAYERDEPENDS_myir-remi-1g = "core yocto yoctobsp openembedded-layer meta-python"

# We have a conf and classes directory, add to BBPATH
BBPATH .= ":${LAYERDIR}"

# We have recipes-* directories, add to BBFILES
BBFILES += "${LAYERDIR}/recipes-*/*/*.bb \
    ${LAYERDIR}/recipes-*/*/*.bbappend \
    ${LAYERDIR}/recipes-*/*.bb \
    ${LAYERDIR}/recipes-*/*.bbappend \
    ${LAYERDIR}/recipes-*/*/*/*.bb \
    ${LAYERDIR}/recipes-*/*/*/*.bbappend"

# We only include the recipes-qt if we are having the QT_LAYER in bbconfig layer.
QTDIR = "${LAYERDIR}/dynamic-layers/qt5-layer"
BBFILES += "${@'${QTDIR}/*/*.bb	${QTDIR}/*/*.bbappend' if ('${QT_LAYER}' == 'True') else ' '}"
BBMASK_append = " qtwebengine "
BBMASK += " ${LAYERDIR}/recipes-common/recipes-codec/"
BBMASK += " ${LAYERDIR}/recipes-common/recipes-codec/*/*.bb"
BBMASK += " ${LAYERDIR}/recipes-common/recipes-codec/*/*.bbappend"
#vpu
USE_VIDEO_OMX = "0"

#gpu
BBMASK += " ${LAYERDIR}/recipes-common/recipes-graphics/mali/"
BBMASK += " ${LAYERDIR}/recipes-common/recipes-graphics/mali/*.bb"
BBMASK += " ${LAYERDIR}/recipes-common/recipes-graphics/mali/*.bbappend"
#USE_RENESAS_GLES = "0"
# The .bbappend and .bb files are included if the respective layer
# collection is available.
BBFILES += "${@' '.join('${LAYERDIR}/dynamic-layers/%s/*/*.bbappend' % layer \
               for layer in BBFILE_COLLECTIONS.split())}"
BBFILES += "${@' '.join('${LAYERDIR}/dynamic-layers/%s/*/*.bb' % layer \
               for layer in BBFILE_COLLECTIONS.split())}"

PACKAGECONFIG_GL = "${@bb.utils.contains('DISTRO_FEATURES', 'opengl', 'gles2', '', d)}"


BBFILE_COLLECTIONS += "myir-yg2lx"
BBFILE_PATTERN_myir-yg2lx = "^${LAYERDIR}/"
BBFILE_PRIORITY_myir-yg2lx = "99"
LAYERSERIES_COMPAT_myir-yg2lx = "dunfell"

BBFILE_COLLECTIONS += "myir-yg2lx-1g"
BBFILE_PATTERN_myir-yg2lx-1g = "^${LAYERDIR}/"
BBFILE_PRIORITY_myir-yg2lx-1g = "99"
LAYERSERIES_COMPAT_myir-yg2lx-1g = "dunfell"

BBFILE_COLLECTIONS += "myir-remi"
BBFILE_PATTERN_myir-remi = "^${LAYERDIR}/"
BBFILE_PRIORITY_myir-remi = "99"
LAYERSERIES_COMPAT_myir-remi = "dunfell"

BBFILE_COLLECTIONS += "myir-remi-1g"
BBFILE_PATTERN_myir-remi-1g = "^${LAYERDIR}/"
BBFILE_PRIORITY_myir-remi-1g = "99"
LAYERSERIES_COMPAT_myir-remi-1g = "dunfell"

HOSTTOOLS += "xz"
```

## layers/meta-myir-remi/conf/machine/myir-remi-1g.conf
```bitbake
#@TYPE: Machine
#@NAME: myir-yg2lx machine
#@DESCRIPTION: RZ/G2L myir platform

SOC_FAMILY = "r9a07g044l"
require conf/machine/include/rzg2l-common.inc
require conf/machine/include/cip-core.inc

DEFAULTTUNE ?= "cortexa55"

TUNE_CONF ?= "conf/machine/include/tune-cortexa55.inc"
require ${TUNE_CONF}

PREFERRED_PROVIDER_virtual/kernel="linux-myir"
COMPATIBLE_MACHINE_myir-remi-1g = "myir-remi-1g"
DISTRO_FEATURES_append = " qt5"
DISTRO_FEATURES_append = " virtualization"

MACHINE_EXTRA_RRECOMMENDS = "kernel-modules"
#MACHINE_FEATURES += "watchdog"

UBOOT_CONFIG ??= "mys-rzg2l"
#2G DDR
#UBOOT_CONFIG[myc-rzg2l] = "myc-rzg2l_defconfig"

#1G DDR
UBOOT_CONFIG[mys-rzg2l] = "mys-rzg2l_defconfig"

# flash writer
EXTRA_IMAGEDEPENDS += " flash-writer"

# Support board with PMIC. Default:yes.
# With this option enabled, build both bin files for PMIC board and Concrete board.
PMIC_SUPPORT ?= "1"

# Supported devicetree
#KERNEL_DEVICETREE = " \
#	renesas/r9a07g044l2-smarc.dtb \
#"
#KERNEL_DEVICETREE = " \
#       myir/myb-rzg2l-hdmi.dtb \ 
#"


KERNEL_DEVICETREE = " \
       myir/mys-rzg2l-wifi.dtb \
       myir/mys-rzg2l-sdcard.dtb \
"
```

## layers/meta-myir-remi/conf/machine/myir-yg2lx-1g.conf
```bitbake
#@TYPE: Machine
#@NAME: myir-yg2lx machine
#@DESCRIPTION: RZ/G2L myir platform

SOC_FAMILY = "r9a07g044l"
require conf/machine/include/rzg2l-common.inc
require conf/machine/include/cip-core.inc

DEFAULTTUNE ?= "cortexa55"

TUNE_CONF ?= "conf/machine/include/tune-cortexa55.inc"
require ${TUNE_CONF}

PREFERRED_PROVIDER_virtual/kernel="linux-myir"
COMPATIBLE_MACHINE_myir-yg2lx-1g = "myir-yg2lx-1g"
DISTRO_FEATURES_append = " qt5"
DISTRO_FEATURES_append = " virtualization"

MACHINE_EXTRA_RRECOMMENDS = "kernel-modules"
#MACHINE_FEATURES += "watchdog"

UBOOT_CONFIG ??= "myc-rzg2l"
#2G DDR
#UBOOT_CONFIG[myc-rzg2l] = "myc-rzg2l_defconfig"

#1G DDR
UBOOT_CONFIG[myc-rzg2l] = "myc-rzg2l_ddr1gb_defconfig"

# flash writer
EXTRA_IMAGEDEPENDS += " flash-writer"

# Support board with PMIC. Default:yes.
# With this option enabled, build both bin files for PMIC board and Concrete board.
PMIC_SUPPORT ?= "1"

# Supported devicetree
#KERNEL_DEVICETREE = " \
#	renesas/r9a07g044l2-smarc.dtb \
#"
#KERNEL_DEVICETREE = " \
#       myir/myb-rzg2l-hdmi.dtb \ 
#"


KERNEL_DEVICETREE = " \
       myir/myb-rzg2l-disp.dtb \
       myir/myb-rzg2l-hdmi.dtb \
"
```

## layers/meta-myir-rzfive-rzg2ul/conf/layer.conf
```bitbake
# We have a conf and classes directory, add to BBPATH
include ${LAYERDIR}/include/graphic/rz-graphics.inc
include ${LAYERDIR}/include/rz-plugins.inc
include ${LAYERDIR}/include/openamp/openamp.inc
BBPATH .= ":${LAYERDIR}"

# We have recipes-* directories, add to BBFILES
BBFILES += "${LAYERDIR}/recipes-*/*/*.bb \
    ${LAYERDIR}/recipes-*/*/*.bbappend \
    ${LAYERDIR}/recipes-*/*.bb \
    ${LAYERDIR}/recipes-*/*.bbappend \
    ${LAYERDIR}/recipes-*/*/*/*.bb \
    ${LAYERDIR}/recipes-*/*/*/*.bbappend"

BBFILES_DYNAMIC += " \
    qt5-layer:${LAYERDIR}/dynamic-layers/qt5-layer/*/*.bb \
    qt5-layer:${LAYERDIR}/dynamic-layers/qt5-layer/*/*.bbappend \
    virtualization-layer:${LAYERDIR}/dynamic-layers/virtualization-layer/*/*.bb \
    virtualization-layer:${LAYERDIR}/dynamic-layers/virtualization-layer/*/*.bbappend \
"
PREFERRED_VERSION_python-native = "2.7.18%"
PREFERRED_VERSION_python = "2.7.18%"
#

PREFERRED_VERSION_python-setuptools = "42.0.2%"
PREFERRED_VERSION_python-flask = "1.1.1%"
PREFERRED_VERSION_python-flask-sqlalchemy = "2.4.1%"
PREFERRED_VERSION_python-flask-babel = "0.12.2%"
PREFERRED_VERSION_python-flask-bootstrap = "3.3.7%"
PREFERRED_VERSION_python-flask-pymongo = "2.3.0%"
PREFERRED_VERSION_python-flask-nav = "0.6%"
PREFERRED_VERSION_python-pytz = "2019.3%"
PREFERRED_VERSION_python-dateutil = "2.8.1%"
PREFERRED_VERSION_python-backports-abc = "0.5%"
PREFERRED_VERSION_python-certifi = "2019.11.28%"
PREFERRED_VERSION_python-chardet = "3.0.4%"
PREFERRED_VERSION_python-click = "7.0%"
PREFERRED_VERSION_python-dbus = "1.2.14%"

#PREFERRED_VERSION_python-werkzeug = "0.16.0%"
#PREFERRED_VERSION_python-pygobject = "3.28.3%"
#BBMASK_append = " qtwebengine "
#BBMASK += "recipes-debian/buster/pseudo/pseudo_debian.bb"
#BBMASK += "recipes-debian/buster/binutils/binutils-cross_debian.bb"
# We have recipes-debian sub-directories that contained CIP-Core packages, add to BBFILES based on config CIP_MODE
CIPDIR = "${LAYERDIR}/recipes-common/recipes-debian"
BBFILES += "${@'${CIPDIR}/buster/*/*.bb	${CIPDIR}/buster/*/*.bbappend' if ('${CIP_MODE}' == 'Buster') else ' '}"
BBFILES += "${@'${CIPDIR}/bullseye/*/*.bb ${CIPDIR}/bullseye/*/*.bbappend' if ('${CIP_MODE}' == 'Bullseye') else ' '}"

BBFILE_COLLECTIONS += "myir-rzfive-rzg2ul"
BBFILE_PATTERN_myir-rzfive-rzg2ul = "^${LAYERDIR}/"
BBFILE_PRIORITY_myir-rzfive-rzg2ul = "15"
#PACKAGECONFIG_append_pn-qtbase = " opengl"
PACKAGECONFIG_GL = "${@bb.utils.contains('DISTRO_FEATURES', 'opengl', 'gles2', '', d)}"
DISTRO_FEATURES_append = " virtualization"
PREFERRED_PROVIDER_virtual/kernel="linux-myir"
PREFERRED_PROVIDER_virtual/bootloader="u-boot-myir"

LAYERDEPENDS_myir-rzfive-rzg2ul = "core yocto yoctobsp openembedded-layer meta-python"
LAYERSERIES_COMPAT_myir-rzfive-rzg2ul = "dunfell"

HOSTTOOLS += "xz"
```

## layers/meta-myir-rzfive-rzg2ul/conf/machine/include/rzg2-common.inc
```bitbake
EXT_GFX_BACKEND = "${@bb.utils.contains('COMBINED_FEATURES', 'opengles', '1', '0', d)}"

# 32BIT package install (default is disable)
# This variables can be used only in multilib.
USE_32BIT_PKGS ?= "0"
USE_32BIT_WAYLAND ?= "0"
USE_32BIT_MMP ?= "0"

MACHINE_FEATURES = ""

KERNEL_IMAGETYPE = "Image"
IMAGE_FSTYPES_append = " tar.bz2 ext4 "

SERIAL_CONSOLES = "115200;ttySC0"

# Configuration for ARM Trusted Firmware
EXTRA_IMAGEDEPENDS += " tf-a-myir"

# Add variable to Build Configuration in build log
BUILDCFG_VARS_append = " SOC_FAMILY"

# We must disable ptest when can not use GPLv3 License,
# ptest require many package, which have GPLv3 License,
DISTRO_FEATURES_remove += "${@bb.utils.contains("INCOMPATIBLE_LICENSE", "GPLv3", "ptest", "",d)}"

# Match version between native and target sysroot in meta-gplv2 when not using GPLv3.
PREFERRED_VERSION_gdbm-native ?= "${@bb.utils.contains("INCOMPATIBLE_LICENSE", "GPLv3", "1.8.3", "",d)}"

# u-boot
PREFERRED_VERSION_u-boot-myir = "v2021.10%"
EXTRA_IMAGEDEPENDS += " u-boot-myir"

DISTRO_FEATURES_append = " docker"

UBI_VOLNAME = "rootfs"
# The biggest NANDs on current modules are 256MB.
# This sums up to 2048 LEBs available for the ubifs (-c)
#MKUBIFS_ARGS = "-F -m 2048 -e 126976 -c 2048"
MKUBIFS_ARGS = "-F -m 2048 -e 126976 -c 4900"
UBINIZE_ARGS = "-m 2048 -p 128KiB -s 2048 -O 2048"
```

## layers/meta-myir-rzfive-rzg2ul/meta-rzfive/conf/layer.conf
```bitbake
# We have a conf and classes directory, add to BBPATH
BBPATH .= ":${LAYERDIR}"

# We have recipes-* directories, add to BBFILES
BBFILES += "${LAYERDIR}/recipes-*/*/*.bb \
            ${LAYERDIR}/recipes-*/*/*.bbappend \
            ${LAYERDIR}/recipes-*/*.bb \
            ${LAYERDIR}/recipes-*/*.bbappend"

BBFILE_COLLECTIONS += "rzfive"
BBFILE_PATTERN_rzfive = "^${LAYERDIR}/"
BBFILE_PRIORITY_rzfive = "15"

#BBMASK += "recipes-common/recipes-debian/buster/binutils/binutils-cross_debian.bb"
#BBMASK += "recipes-common/recipes-debian/buster/pseudo/pseudo_debian.bb"
#BBMASK += "recipes-common/recipes-debian/buster/binutils/binutils_debian.bb"
BBMASK += "recipes-common/recipes-graphics/mali/*"
BBMASK += "recipes-common/recipes-graphics/mali/*.bb"
BBMASK += "recipes-common/recipes-graphics/mali/*.bbappend"
BBMASK += "recipes-common/recipes-openamp/open-amp/*.bb"
BBMASK += "layers/meta-qt5/recipes-qt/qt5/qt3d_git.bb"
PREFERRED_VERSION_go-runtime = "1.16%"
PREFERRED_VERSION_go-native = "1.16%"
PREFERRED_VERSION_go-cross = "1.16%"
PREFERRED_VERSION_go = "1.16%"
USE_OPENAMP = "0"
USE_QT3d = "0"
MEASY-COMMAND-RZFIVE = "1"
LAYERDEPENDS_rzfive = "myir-rzfive-rzg2ul"
LAYERSERIES_COMPAT_rzfive = "dunfell"
```

## layers/meta-myir-rzfive-rzg2ul/meta-rzg2ul/conf/layer.conf
```bitbake
# We have a conf and classes directory, add to BBPATH
BBPATH .= ":${LAYERDIR}"

# We have recipes-* directories, add to BBFILES
BBFILES += "${LAYERDIR}/recipes-*/*/*.bb \
            ${LAYERDIR}/recipes-*/*/*.bbappend \
            ${LAYERDIR}/recipes-*/*.bb \
            ${LAYERDIR}/recipes-*/*.bbappend"

BBFILE_COLLECTIONS += "rzg2ul"
BBFILE_PATTERN_rzg2ul = "^${LAYERDIR}/"
BBFILE_PRIORITY_rzg2ul = "15"
#BBMASK += "recipes-common/recipes-debian/buster/binutils/binutils-cross_debian.bb"
#BBMASK += "recipes-common/recipes-debian/buster/pseudo/pseudo_debian.bb"
#BBMASK += "recipes-common/recipes-debian/buster/binutils/binutils_debian.bb"
USE_QT3d = "1"
QT-DEMO = "1"
MEASY-IOT = "1"
MEASY-COMMAND = "1"
RPMSG-SAMPLE = "1"
LAYERDEPENDS_rzg2ul = "myir-rzfive-rzg2ul"
LAYERSERIES_COMPAT_rzg2ul = "dunfell"
```

## layers/meta-myir-rzfive-rzg2ul/meta-rzg2ul/conf/machine/myir-rzg2ul.conf
```bitbake
#@TYPE: Machine
#@NAME: myir-rzg2ul machine
#@DESCRIPTION: RZ/G2UL MYIR platform

SOC_FAMILY = "r9a07g043u"
require conf/machine/include/rzg2l-common.inc
require conf/machine/include/cip-core.inc

DEFAULTTUNE ?= "cortexa55"

TUNE_CONF ?= "conf/machine/include/tune-cortexa55.inc"
require ${TUNE_CONF}

PREFERRED_PROVIDER_virtual/kernel = "linux-myir"
COMPATIBLE_MACHINE_myir-rzg2ul = "myir-rzg2ul"

UBOOT_CONFIG ??= "myc-rzg2ul"
UBOOT_CONFIG[myc-rzg2ul] = "myc-rzg2ul_defconfig"

# flash writer
EXTRA_IMAGEDEPENDS += " flash-writer"

# Supported devicetree
KERNEL_DEVICETREE = " \
	myir/myb-rzg2ul-disp.dtb \
"
```

## layers/meta-myir-yg2lx/conf/layer.conf
```bitbake
include ${LAYERDIR}/include/codec/plugin.inc
include ${LAYERDIR}/include/demos/demos.inc
#include ${LAYERDIR}/include/codec/plugin.inc
#include ${LAYERDIR}/include/codec/omx-control.inc
include ${LAYERDIR}/include/openamp/openamp.inc
include ${LAYERDIR}/include/graphic/feature.inc
#include ${LAYERDIR}/include/rz-plugins.inc
#include ${LAYERDIR}/include/rz-graphics.inc

LAYERDEPENDS_myir-yg2lx = "core"
LAYERDEPENDS_myir-yg2lx = "core yocto yoctobsp openembedded-layer meta-python"

LAYERDEPENDS_myir-yg2lx-1g = "core"
LAYERDEPENDS_myir-yg2lx-1g = "core yocto yoctobsp openembedded-layer meta-python"


# We have a conf and classes directory, add to BBPATH
BBPATH .= ":${LAYERDIR}"

# We have recipes-* directories, add to BBFILES
BBFILES += "${LAYERDIR}/recipes-*/*/*.bb \
    ${LAYERDIR}/recipes-*/*/*.bbappend \
    ${LAYERDIR}/recipes-*/*.bb \
    ${LAYERDIR}/recipes-*/*.bbappend \
    ${LAYERDIR}/recipes-*/*/*/*.bb \
    ${LAYERDIR}/recipes-*/*/*/*.bbappend"

# We only include the recipes-qt if we are having the QT_LAYER in bbconfig layer.
QTDIR = "${LAYERDIR}/dynamic-layers/qt5-layer"
BBFILES += "${@'${QTDIR}/*/*.bb	${QTDIR}/*/*.bbappend' if ('${QT_LAYER}' == 'True') else ' '}"
BBMASK_append = " qtwebengine "
BBMASK += " ${LAYERDIR}/recipes-common/recipes-codec/"
BBMASK += " ${LAYERDIR}/recipes-common/recipes-codec/*/*.bb"
BBMASK += " ${LAYERDIR}/recipes-common/recipes-codec/*/*.bbappend"
USE_VIDEO_OMX = "0"
# The .bbappend and .bb files are included if the respective layer
# collection is available.
BBFILES += "${@' '.join('${LAYERDIR}/dynamic-layers/%s/*/*.bbappend' % layer \
               for layer in BBFILE_COLLECTIONS.split())}"
BBFILES += "${@' '.join('${LAYERDIR}/dynamic-layers/%s/*/*.bb' % layer \
               for layer in BBFILE_COLLECTIONS.split())}"

PACKAGECONFIG_GL = "${@bb.utils.contains('DISTRO_FEATURES', 'opengl', 'gles2', '', d)}"


BBFILE_COLLECTIONS += "myir-yg2lx"
BBFILE_PATTERN_myir-yg2lx = "^${LAYERDIR}/"
BBFILE_PRIORITY_myir-yg2lx = "99"
LAYERSERIES_COMPAT_myir-yg2lx = "dunfell"

BBFILE_COLLECTIONS += "myir-yg2lx-1g"
BBFILE_PATTERN_myir-yg2lx-1g = "^${LAYERDIR}/"
BBFILE_PRIORITY_myir-yg2lx-1g = "99"
LAYERSERIES_COMPAT_myir-yg2lx-1g = "dunfell"


HOSTTOOLS += "xz"
```

## layers/meta-renesas/meta-rzg2l/conf/layer.conf
```bitbake
# We have a conf and classes directory, add to BBPATH
BBPATH .= ":${LAYERDIR}"

# We have recipes-* directories, add to BBFILES
BBFILES += "${LAYERDIR}/recipes-*/*/*.bb \
            ${LAYERDIR}/recipes-*/*/*.bbappend"

BBFILE_COLLECTIONS += "rzg2l"
BBFILE_PATTERN_rzg2l = "^${LAYERDIR}/"
BBFILE_PRIORITY_rzg2l = "15"
BBMASK += "meta-rz-common/recipes-debian/buster/binutils/binutils-cross_debian.bb"
BBMASK += "meta-rz-common/recipes-debian/buster/pseudo/pseudo_debian.bb"
BBMASK += "meta-rz-common/recipes-debian/buster/binutils/binutils_debian.bb"

LAYERDEPENDS_rzg2l = "rz-common"
LAYERSERIES_COMPAT_rzg2l = "dunfell"
```
